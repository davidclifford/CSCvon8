const char ADDR[] = {22, 24, 26, 28, 30, 32, 34, 36, 38, 40, 42, 44, 46, 48, 50, 52};
const char DATA[] = {31, 33, 35, 37, 39, 41, 43, 45};
#define WRITE 53
#define RED 0b00110000
#define GREEN 0b00001100
#define BLUE 0b00000011

PROGMEM const char finch[]  = {47,46,46,46,46,46,42,42,42,42,42,42,42,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62,
46,46,46,46,46,46,46,42,42,42,42,42,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63,
46,46,46,46,46,46,46,42,42,42,42,42,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63,
46,46,46,46,46,46,46,42,42,42,42,42,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63,
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62,57,41,37,57,57,62,62,61,57,57,57,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46,
  };

void setup() {

  for (int n = 0; n < 16; n += 1) {
    pinMode(ADDR[n], OUTPUT);
  }
  for (int n = 0; n < 8; n += 1) {
    pinMode(DATA[n], OUTPUT);
  }
  pinMode(WRITE, OUTPUT);

  clear_screen();
}

void draw_finch() {

  for (int y = 0; y < 120; y++) {
    for (int x = 0; x < 160; x+=1) { 
      plot(x, y, pgm_read_word_near(finch+x+y*160));
    }
  }    
}

void draw_diagonals() {
  for (int y = 0; y < 120; y++) {
    for (int x = 0; x < 160; x+=1) { 
      plot(x, y, (x+y)&63);
    }
  }    
}

void draw_stripes() {
  for (int y = 0; y < 120; y++) {
    for (int x = 0; x < 160; x+=1) {
      int c = 0;
      if (x%8 == 1) c = RED;
      if (x%8 == 2) c = GREEN;
      if (x%8 == 3) c = GREEN | RED;      
      if (x%8 == 4) c = BLUE;      
      if (x%8 == 5) c = RED | BLUE;      
      if (x%8 == 6) c = GREEN | BLUE;      
      if (x%8 == 7) c = RED | GREEN | BLUE;      
      plot(x, y, c);
    }
  }    
}

void clear_screen() {
  for (int y = 0; y < 128; y++) {
    for (int x = 0; x < 256; x ++) {
      int addr = y << 8 | x;
      set_address(addr);
      set_data(0);
      pulse_write();
    }
  }  
}

void plot(int x, int y, int c){
    int addr = y << 8 | x;
    set_address(addr);
    set_data(c);
    pulse_write();
//    delay(1000);
}
void set_address(int address) {
  for (int i = 0; i < 16; i++) {
    digitalWrite(ADDR[i], ((address>>i)&1));
  }
}

void set_data(int data) {
  for (int i = 0; i < 8; i++) {
    digitalWrite(DATA[i], ((data>>i)&1));
  }
}

void pulse_write() {
  digitalWrite(WRITE, 0);
  digitalWrite(WRITE, 1);
  digitalWrite(WRITE, 0);    
}

void loop() {
  draw_finch();
  delay(1000);
  draw_stripes();
  delay(1000);
  draw_diagonals();
  delay(1000);
}
